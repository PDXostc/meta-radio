## conf/layer.conf
```bitbake
BBPATH .= ":${LAYERDIR}"
BBFILES += "${LAYERDIR}/recipes-*/*/*.bb \
            ${LAYERDIR}/recipes-*/*/*.bbappend"
BBFILE_COLLECTIONS += "radio"
BBFILE_PATTERN_radio = "^${LAYERDIR}/"
BBFILE_PRIORITY_radio = "5"
LAYERVERSION_radio = "1"
```
